## boards/shields/68keys/Kconfig.defconfig
```kconfig
if SHIELD_68KEYS_RIGHT

config ZMK_KEYBOARD_NAME
    default "68keys"

endif

if SHIELD_68KEYS_LEFT || SHIELD_68KEYS_RIGHT

config ZMK_SPLIT
    default y

endif
```

## boards/shields/68keys/Kconfig.shield
```kconfig
config SHIELD_68KEYS_LEFT
    def_bool $(shields_list_contains,68keys_left)
config SHIELD_68KEYS_RIGHT
    def_bool $(shields_list_contains,68keys_right)
```
